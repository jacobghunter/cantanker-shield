## boards/shields/cantanker/Kconfig.defconfig
```kconfig
if SHIELD_CANTANKER_LEFT || SHIELD_CANTANKER_RIGHT

# Name must be less than 16 characters long!
config ZMK_KEYBOARD_NAME
    default "Cantanker"

config ZMK_SPLIT
    default y

# For the left side to be the central side.
config ZMK_SPLIT_ROLE_CENTRAL
    default y if SHIELD_CANTANKER_LEFT

endif
```

## boards/shields/cantanker/Kconfig.shield
```kconfig
# Copyright (c) 2020 Ryan Cross
# SPDX-License-Identifier: MIT

config SHIELD_CANTANKER_LEFT
    def_bool $(shields_list_contains,cantanker_left)

config SHIELD_CANTANKER_RIGHT
    def_bool $(shields_list_contains,cantanker_right)
```

## boards/shields/sofle_custom/Kconfig.shield
```kconfig
# Copyright (c) 2020 Ryan Cross
# SPDX-License-Identifier: MIT

config SHIELD_SOFLE_CUSTOM_LEFT
    def_bool $(shields_list_contains,sofle_custom_left)

config SHIELD_SOFLE_CUSTOM_RIGHT
    def_bool $(shields_list_contains,sofle_custom_right)
```

## config/west.yml
```yaml
manifest:
  defaults:
    revision: v0.3
  remotes:
    - name: zmkfirmware
      url-base: https://github.com/zmkfirmware
    - name: jacobghunter
      url-base: https://github.com/jacobghunter
  projects:
    - name: zmk
      remote: zmkfirmware
      import: app/west.yml
    - name: zmk-driver-azoteq-iqs5xx
      remote: jacobghunter
      revision: main
    - name: cantanker-shield
      remote: jacobghunter
      revision: main
      path: cantanker-shield
  self:
    path: config
```
