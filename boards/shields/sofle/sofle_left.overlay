/*
 * Copyright (c) 2020 Ryan Cross
 *
 * SPDX-License-Identifier: MIT
 */

#include "sofle.dtsi"

&kscan0 {
    // col-gpios
    //     = <&gpio0 21 GPIO_ACTIVE_HIGH>
    //     , <&gpio0 20 GPIO_ACTIVE_HIGH>
    //     , <&gpio0 19 GPIO_ACTIVE_HIGH>
    //     , <&gpio0 18 GPIO_ACTIVE_HIGH>
    //     , <&gpio0 15 GPIO_ACTIVE_HIGH>
    //     , <&gpio0 14 GPIO_ACTIVE_HIGH>
    //     , <&gpio0 9 GPIO_ACTIVE_HIGH>
    //     ;
    col-gpios
        = <&pro_micro 21 GPIO_ACTIVE_HIGH>
        , <&pro_micro 20 GPIO_ACTIVE_HIGH>
        , <&pro_micro 19 GPIO_ACTIVE_HIGH>
        , <&pro_micro 18 GPIO_ACTIVE_HIGH>
        , <&pro_micro 15 GPIO_ACTIVE_HIGH>
        , <&pro_micro 14 GPIO_ACTIVE_HIGH>
        ;
};

&left_encoder {
    status = "okay";
};
