#include <dt-bindings/input/input.h>

/ {
    gpio_keys {
        compatible = "gpio-keys";
        encoder_click: encoder_click {
            label = "ENCODER_CLICK";
            gpios = <&pro_micro 8 (GPIO_ACTIVE_LOW | GPIO_PULL_UP)>;
            // Use a unique, unused keycode for mapping.
            // This will be mapped to MCLK in the keymap.
            linux,code = <INPUT_KEY_PROG1>;
        };
    };
};
