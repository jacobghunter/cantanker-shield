#include "cantanker.dtsi"
#include <dt-bindings/zmk/matrix_transform.h>
#include <input/processors.dtsi>

  &kscan0 {
      row-gpios
          = <&pro_micro 1 (GPIO_ACTIVE_HIGH | GPIO_PULL_DOWN)>
          , <&pro_micro 0 (GPIO_ACTIVE_HIGH | GPIO_PULL_DOWN)>
          , <&pro_micro 2 (GPIO_ACTIVE_HIGH | GPIO_PULL_DOWN)>
          , <&pro_micro 3 (GPIO_ACTIVE_HIGH | GPIO_PULL_DOWN)>
          , <&gpio1 2 (GPIO_ACTIVE_HIGH | GPIO_PULL_DOWN)>
          ;

      col-gpios
          = <&pro_micro 21 GPIO_ACTIVE_HIGH>
          , <&pro_micro 20 GPIO_ACTIVE_HIGH>
          , <&pro_micro 19 GPIO_ACTIVE_HIGH>
          , <&pro_micro 18 GPIO_ACTIVE_HIGH>
          , <&pro_micro 15 GPIO_ACTIVE_HIGH>
          , <&pro_micro 14 GPIO_ACTIVE_HIGH>
          , <&pro_micro 9  GPIO_ACTIVE_HIGH>
          ;
  };

  &left_encoder {
      status = "okay";
  };



  &tps43_input {
      status = "okay";
      input-processors = <&zip_xy_scaler 1 1 &zip_temp_layer 4 250>;
  };
